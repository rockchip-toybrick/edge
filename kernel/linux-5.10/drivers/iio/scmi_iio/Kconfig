## kernel/linux-5.10/drivers/iio/scmi_iio/Kconfig
```kconfig
# SPDX-License-Identifier: GPL-2.0-only

# SCMI IIO
# System Control and Management Interface(SCMI) based IIO sensor driver
#
# When adding new entries keep the list in alphabetical order

menu "scmi iio"

config IIO_SCMI
	tristate "SCMI base IIO sensor"
	help
	  Say Y here if you want to build a driver for SCMI sensor.

	  To compile this driver as a module, choose M here.

endmenu
```

## kernel/linux-5.10/drivers/misc/virtio/Kconfig
```kconfig
# SPDX-License-Identifier: GPL-2.0-only

config VIRTIO_MISC
	tristate "Virtio misc driver"
	depends on VIRTIO
	help
	 This option adds virtio misc driver.
```

## kernel/linux-5.10/drivers/video/virtio/Kconfig
```kconfig
# SPDX-License-Identifier: GPL-2.0-only

config VIRTIO_VIDEO
	tristate "Virtio video driver"
	depends on VIRTIO
	select V4L2_MEM2MEM_DEV
	select VIDEOBUF2_DMA_SG
	select VIDEOBUF2_DMA_CONTIG

	help
	 This option adds virtio video driver.
```

## kernel/linux-5.10/sound/virtio/Kconfig
```kconfig
# SPDX-License-Identifier: GPL-2.0-only

config VIRTIO_SND
	tristate "Virtio sound driver"
	depends on VIRTIO
	help
	 This option adds virtio sound driver.
```
