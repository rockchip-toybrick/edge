// SPDX-License-Identifier: (GPL-2.0+ OR MIT)
/*
 * Copyright (c) 2021 Rockchip Electronics Co., Ltd.
 *
 */

/dts-v1/;

#include "rk3588s-toybrick-d0.dtsi"
#include "rk3588-linux.dtsi"
//#include "rk3588s-toybrick-d0-imx258.dtsi"

/ {
	model = "Rockchip RK3588s Toybrick D0 Board";
	compatible = "rockchip,rk3588s-toybrick-d0-linux", "rockchip,rk3588";
};
